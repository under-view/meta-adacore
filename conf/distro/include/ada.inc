## conf/distro/include/ada.inc
```bitbake
DISTROOVERRIDES =. "ada:"

PREFERRED_PROVIDER_virtual/gnat1 ??= "alire-gnat-native"
PREFERRED_PROVIDER_virtual/gprbuild1 ??= "alire-gprbuild-native"
```

## conf/layer.conf
```bitbake
# We have a conf and classes directory, add to BBPATH
BBPATH .= ":${LAYERDIR}"

# We have recipes-* directories, add to BBFILES
BBFILES += "${LAYERDIR}/recipes-*/*/*.bb \
            ${LAYERDIR}/recipes-*/*/*.bbappend"

BBFILE_COLLECTIONS += "meta-adacore"
BBFILE_PATTERN_meta-adacore = "^${LAYERDIR}/"
BBFILE_PRIORITY_meta-adacore = "6"

LAYERDEPENDS_meta-adacore = "core"
LAYERSERIES_COMPAT_meta-adacore = "nanbield"
```
